## meta-rockchip-rv1106/conf/distro/luckfox-rv1106.conf
```bitbake
# Luckfox RV1106 distribution configuration.
#
# Self-contained — does not require meta-luckfox-distro from the
# RK3506-focused luckfox-yocto repo. Targets the RV1106-based
# Luckfox Pico Ultra W (and any future RV1106 boards).

DISTRO = "luckfox-rv1106"
DISTRO_NAME = "Luckfox RV1106 Linux"
DISTRO_VERSION = "0.1"
DISTRO_CODENAME = "experimental"

# Yocto release compatibility
SANITY_TESTED_DISTROS ?= ""

# Init system: systemd is fine on the RV1106 boards we ship (256 MB DDR3L)
INIT_MANAGER = "systemd"
DISTRO_FEATURES:append = " systemd"
VIRTUAL-RUNTIME_init_manager = "systemd"
VIRTUAL-RUNTIME_initscripts = "systemd-compat-units"

# Base distro features
DISTRO_FEATURES = "largefile ipv4 ipv6 usbhost ${DISTRO_FEATURES_DEFAULT}"

# Headless / framebuffer-only — no X11 / Wayland / GPU stack.
DISTRO_FEATURES:remove = "x11 wayland opengl vulkan"

# Accept commercial licenses for rkbin proprietary blobs (DDR init / SPL / TEE)
LICENSE_FLAGS_ACCEPTED:append = " commercial"

# IPK keeps the on-target package db small
PACKAGE_CLASSES = "package_ipk"

# Default to wic + ext4 for an eMMC-flashable rootfs
IMAGE_FSTYPES ?= "wic ext4"
```

## meta-rockchip-rv1106/conf/layer.conf
```bitbake
# Self-contained Yocto layer for the Rockchip RV1106 SoC family.
#
# Provides everything needed to build a bootable image for the
# Luckfox Pico Ultra W:
#   - Machine config and SoC-family include
#   - Kernel recipe (Luckfox SDK 5.10.x)
#   - U-Boot recipe + rkbin proprietary blobs
#   - WIC partition layout + extlinux config
#   - Distro config (DISTRO = "luckfox-rv1106")
#   - Image recipe (luckfox-image-minimal)
#   - Out-of-tree drivers: AIC8800DC WiFi/BT
#   - Userspace: rknn-runtime, luckfox-pico-status webserver
#
# Must NOT be included alongside meta-rockchip-rk3506 in the same build
# (kernel, U-Boot and rkbin recipes use machine-overridable paths that
# would conflict).

BBPATH .= ":${LAYERDIR}"

BBFILES += " \
    ${LAYERDIR}/recipes-*/*/*.bb \
    ${LAYERDIR}/recipes-*/*/*.bbappend \
"

BBFILE_COLLECTIONS += "rockchip-rv1106"
BBFILE_PATTERN_rockchip-rv1106 = "^${LAYERDIR}/"
BBFILE_PRIORITY_rockchip-rv1106 = "10"

LAYERDEPENDS_rockchip-rv1106 = "core"
LAYERSERIES_COMPAT_rockchip-rv1106 = "scarthgap styhead"
```

## meta-rockchip-rv1106/conf/machine/include/luckfox-rv1106.inc
```bitbake
# Shared machine settings for all LuckFox boards using Rockchip RV1106 SoC family.
# Individual board .conf files include this and set board-specific overrides.

# ARM Cortex-A7 tuning (single-core, 32-bit ARMv7-A with NEON)
require conf/machine/include/arm/armv7a/tune-cortexa7.inc

DEFAULTTUNE = "armv7athf-neon"

# Vendor BSP kernel is 5.10.x — glibc must be told the oldest kernel version
OLDEST_KERNEL = "5.10"

# SoC vendor layer provides kernel and bootloader
PREFERRED_PROVIDER_virtual/kernel = "linux-rockchip-rv1106"
PREFERRED_PROVIDER_virtual/bootloader = "u-boot-rockchip-rv1106"

# Vendor BSP kernel 5.10.x — no mainline alternative exists
PREFERRED_VERSION_linux-rockchip-rv1106 = "5.10%"

# In-tree defconfig for the RV1106 SoC
KBUILD_DEFCONFIG = "rv1106_defconfig"

# Serial console: Rockchip FIQ debugger on UART2
# RV1106 uses 115200 baud (not 1.5 Mbaud like RK3506)
SERIAL_CONSOLES = "115200;ttyFIQ0"

# Kernel console arguments for bootloader
KERNEL_CONSOLE = "ttyFIQ0,115200"

# Image types — Rockchip boot chain requires custom wic layout
IMAGE_FSTYPES = "wic ext4"

# Boot partition contents (kernel + DTB for the bootimg-partition wic plugin)
IMAGE_BOOT_FILES = "zImage ${KERNEL_DEVICETREE}"

# Inherit the Rockchip boot image assembly class
IMAGE_CLASSES += "rockchip-rv1106-image"

# Base machine features common to all RV1106 boards
MACHINE_FEATURES = "usbhost"

# Suppress wic's default /etc/fstab update. wic would otherwise inject a
# `/dev/sda1 /boot vfat defaults 0 0` line because it can't infer the
# eMMC device path from the wks. systemd then waits 90s on boot for the
# phantom /dev/sda1 device, blocks local-fs.target, and drops to
# emergency mode (lighttpd never starts, network units stall, etc.).
# Our base-files fstab is already complete so we can skip the update.
WIC_CREATE_EXTRA_ARGS = "--no-fstab-update"
```

## meta-rockchip-rv1106/conf/machine/luckfox-pico-ultra-w.conf
```bitbake
#@TYPE: Machine
#@NAME: LuckFox Pico Ultra W
#@SOC: Rockchip RV1106G3
#@DESCRIPTION: LuckFox Pico Ultra W with RV1106G3 SoC,
#              256 MB DDR3L, 8 GB eMMC, AIC8800DC WiFi/BT,
#              LF40-480480-ARK display, GT911 touch, PoE.

require conf/machine/include/luckfox-rv1106.inc

# --- U-Boot ---
UBOOT_MACHINE = "rv1106_defconfig"

# --- Kernel device tree ---
KERNEL_DEVICETREE = "rv1106g-luckfox-pico-ultra-w.dtb"

# --- Board hardware features ---
MACHINE_FEATURES += "emmc wifi bluetooth screen"

# --- RAM ---
LUCKFOX_RAM_MB = "256"

# --- Boot media ---
WKS_FILE = "luckfox-rv1106-emmc.wks"
```

## meta-rockchip-rv1106/wic/luckfox-rv1106-emmc.wks
```
# Rockchip RV1106 eMMC partition layout for wic
#
# Boot chain: BootROM loads idbloader.img from sector 64 (32 KiB offset).
# idbloader initializes DDR and loads U-Boot from the uboot partition.
# U-Boot loads the kernel from the boot partition via extlinux.conf.
#
# Layout (512-byte sectors):
#   Sector 0x0000       : MBR / partition table
#   Sector 0x0040 (32K) : idbloader.img (DDR init + SPL)
#   Sector 0x4000 (8M)  : u-boot.img (U-Boot + OP-TEE FIT)
#   Sector 0x8000 (16M) : boot partition (kernel + DTB)
#   Sector 0xC000 (24M) : rootfs partition (fills remaining space)
#
# The IDBlock MUST be at sector 64 — hardcoded in the RV1106 BootROM.

# idbloader.img: DDR init + SPL merged image
part --source rawcopy --sourceparams="file=idbloader.img" --no-table --align 32

# u-boot.img: U-Boot proper + OP-TEE as FIT image
part --source rawcopy --sourceparams="file=u-boot.img" --no-table --align 8192

# Boot partition: kernel zImage + DTB + extlinux/extlinux.conf.
# Note: the per-part --no-fstab-update flag is parsed by wic but not
# consumed by the direct imager, so it has no effect here. The actual
# fstab-update suppression has to come from WIC_CREATE_EXTRA_ARGS in
# the kernel's machine include file (luckfox-rv1106.inc).
bootloader --configfile=extlinux-rv1106.conf
part /boot --source bootimg-partition --sourceparams="loader=u-boot" --fstype=vfat --label boot --align 16384 --size 64 --active

# Root filesystem: ext4, fills remaining space
part / --source rootfs --fstype=ext4 --label rootfs --align 24576
```
